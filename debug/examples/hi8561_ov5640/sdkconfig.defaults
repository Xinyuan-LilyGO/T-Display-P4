## debug/examples/lvgl_usb_display/sdkconfig.defaults.esp32p4
```kconfig
CONFIG_SPIRAM=y
CONFIG_SPIRAM_MODE_HEX=y
CONFIG_SPIRAM_SPEED_200M=y

CONFIG_FORMAT_MJPEG_CAM1=y
CONFIG_UVC_MODE_BULK_CAM1=y
CONFIG_FRAMESIZE_HD=y
CONFIG_UVC_CAM1_FRAMERATE=30
CONFIG_UVC_CAM1_FRAMESIZE_WIDTH=540
CONFIG_UVC_CAM1_FRAMESIZE_HEIGT=1168
CONFIG_UVC_CAM1_MULTI_FRAMESIZE=n
```

## debug/examples/uvc_ov2710/sdkconfig.defaults.esp32p4
```kconfig
CONFIG_ESP_VIDEO_ENABLE_ISP_PIPELINE_CONTROLLER=y

CONFIG_CAMERA_OV2710=y
CONFIG_CAMERA_OV2710_CUSTOMIZED_IPA_JSON_CONFIGURATION_FILE=y
CONFIG_CAMERA_OV2710_CUSTOMIZED_IPA_JSON_CONFIGURATION_FILE_PATH="main/hi8561_ov2710_ipa_config.json"
CONFIG_CAMERA_OV2710_MIPI_RAW10_1920X1080_25FPS=y

CONFIG_FRAMESIZE_FHD=y
CONFIG_UVC_CAM1_FRAMERATE=60
CONFIG_UVC_CAM1_FRAMESIZE_WIDTH=1920
CONFIG_UVC_CAM1_FRAMESIZE_HEIGT=1080
CONFIG_UVC_CAM1_MULTI_FRAMESIZE=y

CONFIG_IDF_EXPERIMENTAL_FEATURES=y

CONFIG_SPIRAM=y

CONFIG_SPIRAM_SPEED_200M=y
```

## debug/examples/uvc_ov5645/sdkconfig.defaults.esp32p4
```kconfig
CONFIG_ESP_VIDEO_ENABLE_ISP_PIPELINE_CONTROLLER=y

CONFIG_CAMERA_OV5645=y
CONFIG_CAMERA_OV5645_MIPI_RGB565_1280X960_30FPS=y

CONFIG_FRAMESIZE_FHD=y
CONFIG_UVC_CAM1_FRAMERATE=30
CONFIG_UVC_CAM1_FRAMESIZE_WIDTH=1280
CONFIG_UVC_CAM1_FRAMESIZE_HEIGT=960
CONFIG_UVC_CAM1_MULTI_FRAMESIZE=y

CONFIG_IDF_EXPERIMENTAL_FEATURES=y

CONFIG_SPIRAM=y

CONFIG_SPIRAM_SPEED_200M=y
```

## debug/examples/uvc_sc2336/sdkconfig.defaults.esp32p4
```kconfig
CONFIG_ESP_VIDEO_ENABLE_ISP_PIPELINE_CONTROLLER=y

CONFIG_CAMERA_SC2336=y
CONFIG_CAMERA_SC2336_CUSTOMIZED_IPA_JSON_CONFIGURATION_FILE=y
CONFIG_CAMERA_SC2336_CUSTOMIZED_IPA_JSON_CONFIGURATION_FILE_PATH="main/hi8561_sc2336_ipa_config.json"

CONFIG_IDF_EXPERIMENTAL_FEATURES=y

CONFIG_SPIRAM=y

CONFIG_SPIRAM_SPEED_200M=y
```

## examples/deep_sleep/sdkconfig.defaults
```kconfig
CONFIG_IDF_TARGET="esp32p4"

CONFIG_SPIRAM=y
CONFIG_SPIRAM_MODE_HEX=y
CONFIG_SPIRAM_SPEED_200M=y

CONFIG_LV_CONF_SKIP=y
CONFIG_LV_COLOR_DEPTH_24=y
CONFIG_LV_FONT_MONTSERRAT_16=y
CONFIG_LV_USE_OBSERVER=y
CONFIG_LV_USE_SYSMON=y
CONFIG_LV_USE_PERF_MONITOR=y
CONFIG_IDF_EXPERIMENTAL_FEATURES=y

CONFIG_ESP_VIDEO_ENABLE_ISP_PIPELINE_CONTROLLER=y

CONFIG_CAMERA_SC2336=y
CONFIG_CAMERA_SC2336_CUSTOMIZED_IPA_JSON_CONFIGURATION_FILE=y
CONFIG_CAMERA_SC2336_CUSTOMIZED_IPA_JSON_CONFIGURATION_FILE_PATH="main/hi8561_sc2336_ipa_config.json"
CONFIG_CAMERA_SC2336_MIPI_RAW8_1920X1080_30FPS=y

//CONFIG_CAMERA_OV2710=y
//CONFIG_CAMERA_OV2710_CUSTOMIZED_IPA_JSON_CONFIGURATION_FILE=y
//CONFIG_CAMERA_OV2710_CUSTOMIZED_IPA_JSON_CONFIGURATION_FILE_PATH="main/hi8561_ov2710_ipa_config.json"
//CONFIG_CAMERA_OV2710_MIPI_RAW10_1920X1080_25FPS=y
```

## main/Kconfig.projbuild
```kconfig
menu "Example Configuration"

    choice
        prompt "Select the example to build"
        default EXAMPLE_BUILD_ES8311_SD_WAV
            config EXAMPLE_BUILD_ES8311_SD_WAV
                bool "es8311_sd_wav"
            config EXAMPLE_BUILD_ESP32C6_AT_HOST_SDIO_UART
                bool "esp32c6_at_host_sdio_uart"
            config EXAMPLE_BUILD_ESP32C6_AT_HOST_SDIO_WIFI
                bool "esp32c6_at_host_sdio_wifi"
            config EXAMPLE_BUILD_SX1262_GFSK_SEND_RECEIVE
                bool "sx1262_gfsk_send_receive"
            config EXAMPLE_BUILD_SX1262_LORA_SEND_RECEIVE
                bool "sx1262_lora_send_receive"
            config EXAMPLE_BUILD_SX1262_TX_CONTINUOUS_WAVE
                bool "sx1262_tx_continuous_wave"
            config EXAMPLE_BUILD_AFE
                bool "afe"
            config EXAMPLE_BUILD_RADIOLIB_SX1262_SEND_RECEIVE
                bool "radiolib_sx1262_send_receive"
            config EXAMPLE_BUILD_CC1101_SEND_RECEIVE
                bool "cc1101_send_receive"
            config EXAMPLE_BUILD_RADIOLIB_CC1101_SEND_RECEIVE
                bool "radiolib_cc1101_send_receive (legacy alias)"
            config EXAMPLE_BUILD_RADIOLIB_NRF24L01_SEND_RECEIVE
                bool "radiolib_nrf24l01_send_receive"
            config EXAMPLE_BUILD_NFC_RFAL_ST25R3916
                bool "nfc-rfal_st25r3916"
            config EXAMPLE_BUILD_SCREEN_TCA8418_LVGL_TOUCH_DRAW
                bool "screen_tca8418_lvgl_touch_draw"
            config EXAMPLE_BUILD_ETHERNET_IPERF
                bool "ethernet_iperf"
            config EXAMPLE_BUILD_USB_ETHERNET_IPERF
                bool "usb_ethernet_iperf"
            config EXAMPLE_BUILD_USB_ETHERNET_IPERF_HOST_MSC
                bool "usb_ethernet_iperf_host_msc"
            config EXAMPLE_BUILD_USB_HOST_MSC
                bool "usb_host_msc"

    endchoice

endmenu
```

## sdkconfig.defaults
```kconfig
CONFIG_LILYGO_DEVICE_DRIVER_T_DISPLAY_P4=y

CONFIG_CPP_BUS_DRIVER_LOG_LEVEL_INFO=y
CONFIG_LILYGO_DEVICE_DRIVER_LOG_LEVEL_INFO=y

CONFIG_IDF_TARGET="esp32p4"
CONFIG_ESPTOOLPY_FLASHSIZE_16MB=y
CONFIG_PARTITION_TABLE_CUSTOM=y
CONFIG_PARTITION_TABLE_CUSTOM_FILENAME="partitions_esp32p4.csv"

CONFIG_SPIRAM=y
CONFIG_SPIRAM_MODE_HEX=y
CONFIG_SPIRAM_SPEED_200M=y

CONFIG_CACHE_L2_CACHE_256KB=y
CONFIG_CACHE_L2_CACHE_LINE_128B=y

CONFIG_FREERTOS_TIMER_TASK_STACK_DEPTH=8192
CONFIG_FREERTOS_HZ=1000

CONFIG_FATFS_LFN_HEAP=y
CONFIG_FATFS_VOLUME_COUNT=2

CONFIG_IDF_EXPERIMENTAL_FEATURES=y

CONFIG_SR_VADN_VADNET1_MEDIUM=y
CONFIG_SR_WN_WN9_HIESP=y
CONFIG_SR_WN_WN9_HILEXIN=y

CONFIG_LV_USE_SYSMON=y
CONFIG_LV_USE_PERF_MONITOR=y
CONFIG_LV_PERF_MONITOR_ALIGN_BOTTOM_RIGHT=y
CONFIG_LV_USE_CLIB_MALLOC=y
CONFIG_LV_DEF_REFR_PERIOD=10
CONFIG_LV_FONT_MONTSERRAT_24=y
CONFIG_LV_FONT_MONTSERRAT_48=y

CONFIG_ETHERNET_PHY_IP101=y
CONFIG_ETHERNET_PHY_RST_GPIO=-1

CONFIG_USB_HOST_HUBS_SUPPORTED=y
CONFIG_USB_HOST_ENABLE_ENUM_FILTER_CALLBACK=y
```
